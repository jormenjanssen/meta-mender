## meta-mender-toradex/conf/layer.conf
```bitbake
# Board specific layer configuration for meta-mender
# Copyright 2017 Riwo Engineering
# Copyright 2016 Mender Software AS

# We have a conf and classes directory, add to BBPATH
BBPATH .= ":${LAYERDIR}"

# We have recipes-* directories, add to BBFILES
BBFILES += "${LAYERDIR}/recipes-*/*/*.bb \
	${LAYERDIR}/recipes-*/*/*.bbappend"

BBFILE_COLLECTIONS += "mender-toradex"
BBFILE_PATTERN_mender-toradex = "^${LAYERDIR}/"
BBFILE_PRIORITY_mender-toradex = "6"
```
